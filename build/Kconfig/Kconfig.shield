## build/Kconfig/Kconfig.shield
```kconfig
osource "/Users/emericopedrazagomez/Documents/zephyr/boards/shields/*/Kconfig.shield"
osource "/Users/emericopedrazagomez/Documents/zephyr/bme68x_iaq/boards/shields/*/Kconfig.shield"
osource "/opt/nordic/ncs/v2.7.0/nrf/boards/shields/*/Kconfig.shield"
```

## build/Kconfig/Kconfig.shield.defconfig
```kconfig
osource "/Users/emericopedrazagomez/Documents/zephyr/boards/shields/*/Kconfig.defconfig"
osource "/Users/emericopedrazagomez/Documents/zephyr/bme68x_iaq/boards/shields/*/Kconfig.defconfig"
osource "/opt/nordic/ncs/v2.7.0/nrf/boards/shields/*/Kconfig.defconfig"
```
